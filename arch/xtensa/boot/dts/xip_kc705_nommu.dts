// SPDX-License-Identifier: GPL-2.0
/dts-v1/;
/include/ "kc705_nommu.dts"

/ {
	compatible = "cdns,xtensa-kc705";
	chosen {
		bootargs = "earlycon=uart8250,mmio32,0x9d050020,115200n8 console=ttyS0,115200n8 debug rw root=mtd:data init=/bin/sh ip=dhcp";
	};
	memory@0 {
		device_type = "memory";
		reg = <0x60000000 0x10000000>;
	};
};
