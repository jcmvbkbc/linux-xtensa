## arch/xtensa/Kconfig
```kconfig
# arch/xtensa/Kconfig:
#
# For a description of the syntax of this configuration file,
# see Documentation/kbuild/kconfig-language.txt.

mainmenu "Linux/Xtensa Kernel Configuration"

config ZONE_DMA
	def_bool y

config XTENSA
	def_bool y
	select HAVE_IDE
	select HAVE_ARCH_KGDB
	select HAVE_OPROFILE
	help
	  Xtensa processors are 32-bit RISC machines designed by Tensilica
	  primarily for embedded systems.  These processors are both
	  configurable and extensible.  The Linux port to the Xtensa
	  architecture supports all processor configurations and extensions,
	  with reasonable minimum requirements, including the Diamond 232L
	  Standard Core.  The Xtensa Linux project has
	  a home page at <http://www.linux-xtensa.org/>.

config RWSEM_XCHGADD_ALGORITHM
	def_bool y

config GENERIC_FIND_NEXT_BIT
	def_bool y

config GENERIC_HWEIGHT
	def_bool y

config GENERIC_HARDIRQS
	def_bool y

config GENERIC_GPIO
	def_bool y

config ARCH_HAS_ILOG2_U32
	def_bool n

config ARCH_HAS_ILOG2_U64
	def_bool n

config NO_IOPORT
	def_bool y

config IRQ_PER_CPU
	def_bool y
	
config HZ
	int
	default 100

source "init/Kconfig"
source "kernel/Kconfig.freezer"

menu "Xtensa Processor type and features"

config MMU
	bool "VARIANT/Core has a Full MMU (TLB, Pages, Protection, etc)"
	depends on !XTENSA_VARIANT_S6000 && !XTENSA_VARIANT_DC232A
	default true
	help
	  Build a Conventional Kernel with full MMU support,
	  ie: it supports a TLB with auto-loading, Page protection.

config VARIANT_IRQ_SWITCH
	def_bool n

config	XTENSA_VARIANT_HASCODE
	bool "This core has variant-specific code that needs to be linked in"
	default false
	help
	  Typical Xtensa core variants don't have variant-specific code,
	  but some do, and if selected will be linked into the kernel.

choice
	prompt "Xtensa Processor Configuration"
	default XTENSA_VARIANT_FSF


config XTENSA_VARIANT_FSF
	bool "fsf - default (not generic) configuration"
	select MMU

config XTENSA_VARIANT_MMUBASELE
	bool "mmubasele - base little-endian processor configuration"
	help
	  This variant refers to a base little-endian processor configuration (mmubasele)
	  that is a subset of the Diamond 232L Standard cores.

config XTENSA_VARIANT_DC232A
	bool "dc232a - Diamond 232L Standard Core Rev.A (LE)"
	help
	  This variant refers to Tensilica's Diamond 232L Standard core Rev.A (LE).

config XTENSA_VARIANT_DC232B
	bool "dc232b - Diamond 232L Standard Core Rev.B (LE)"
	select MMU
	help
	  This variant refers to Tensilica's Diamond 232L Standard core Rev.B (LE).

config XTENSA_VARIANT_S6000
	bool "s6000 - Stretch software configurable processor"
	select VARIANT_IRQ_SWITCH
	select ARCH_REQUIRE_GPIOLIB
	select XTENSA_VARIANT_HASCODE

config XTENSA_VARIANT_CUSTOM
	bool "Custom Xtensa processor configuration"
	help
	Select this variant to use a custom Xtensa processor configuration.
	You will be prompted for a processor variant CORENAME.

endchoice


config XTENSA_VARIANT_CUSTOM_NAME
	string "Xtensa Processor Custom Core Variant Name"
	depends on XTENSA_VARIANT_CUSTOM
	default "CORENAME"
	help
	  Provide the name of a custom Xtensa processor variant.
	  This CORENAME selects arch/xtensa/variant/CORENAME
	  and the xtensa_NAME prefix for the toolchain. Ex:

	        xtensa_dc_b_232l-linux-uclibc-gdb
	        xtensa_dc_b_232l-linux-uclibc-gcc
	               ---------
	               CORENAME
 
	  Dont forget you have to select MMU if you have one.

config XTENSA_VARIANT_NAME
	string
	default "s6000"  if XTENSA_VARIANT_S6000
	default "dc232l" if XTENSA_VARIANT_MMUBASELE
	default "dc232a" if XTENSA_VARIANT_DC232A
	default "dc232b" if XTENSA_VARIANT_DC232B
	default "fsf"    if XTENSA_VARIANT_FSF
	default XTENSA_VARIANT_CUSTOM_NAME if XTENSA_VARIANT_CUSTOM


config XTENSA_UNALIGNED_USER
	bool "Unaligned memory access in user space"
	help
	  The Xtensa architecture currently does not handle unaligned
	  memory accesses in hardware but through an exception handler.
	  Per default, unaligned memory accesses are disabled in user space.

	  Say Y here to enable unaligned memory access in user space.

config XTENSA_UNALIGNED_KERNEL
	bool "Unaligned memory access in kernel space"
	help
	  If the kernel accesses memory with a register that has 
	  a random pointer in it usually will get an EXCCAUSE_UNALIGNED.
	  We don't currently have Double exception processing in the
	  fast_unaligned() handler and the double exceptions hide the
	  original problem with the kernel referencing a bogus pointer.
	  This functionaly is provided to support drivers that need
	  to use unaligned pointers. For now it's likely best to
	  not configure this in. With _kernel_exception now corectly
	  setting up the stack a conventional C backtrace will be
	  available to kgdb/xt-gdb.

	   Say Y here to enable unaligned memory access in user space.

config PREEMPT
	bool "Preemptible Kernel"
	default n
	help
          This option reduces the latency of the kernel when reacting to
          real-time or interactive events by allowing a low priority process to
          be preempted even if it is in kernel mode executing a system call.
          Unfortunately the kernel code has some race conditions if both
          CONFIG_SMP and CONFIG_PREEMPT are enabled, so this option is
          currently disabled if you are building an SMP kernel.

          Say Y here if you are building a kernel for a desktop, embedded
          or real-time system.  Say N if you are unsure.

config MATH_EMULATION
	bool "Math emulation"
	help
	Can we use information of configuration file?

config ARCH_HAS_SMP
	bool "System Supports SMP (MX)"
	default y
	help
	  This option is use to indicate that the system-on-a-chip (SOC)
	  supports Multiprocessing. Multiprocessor support implemented above
	  the CPU core definition and currently needs to be selected manually.

	  Multiprocessor support in implemented with external cache and
	  interrupt controlers. The external cache controler supports
	  cache coherency; thought still in the process of testing.
	  Currently addition cache flushs have been added to get
	  a SMP system to be stable under LTP test for about four days.

	  The MX interrupt distributer adds Interprocessor Interrupts
	  and causes the IRQ numbers to be increased by 4 for devices
	  like the open cores ethernet driver and the serial interface.

	  You still have to select "Enable SMP" to enable SMP on this SOC.
	
config SMP
	bool "Enable Symmetric multi-processing support"
	depends on ARCH_HAS_SMP
	help
	  Enabled SMP Software; allows more than one CPU/CORE
	  to be activated during startup.

config NR_CPUS
        depends on SMP
        int "Maximum number of CPUs (2-32)"
        range 2 32
        default "4"

config LAZY_SMP_COPROCESSOR_REGISTER_FLUSHING
	bool "Enable Lazy Flushing of Coprocessor Registers"
	default true
	depends on SMP
	help
	  Enable SMP configurations to use the classic Lazy Flushing
	  algorithm that's standard for non-SMP configurations. The
	  SMP implementation binds the a task owning a co-processor
	  to it's current processor. Once the task no longer owns
	  the coprocessor, it's no longer bound to the cpu.

	  On SMP systems if not enabled, the coprocessor registers
	  are flushed every time the process switches to another task.
	
	  On Non-SMP systems the existing Lazy Flushing is still always used. 

	  Performance difference doesn't appear to be significant for 
	  configurations with only a few TIE registers; HiFI-2 for example.


config GENERIC_TIME
	bool "Use Generic Time Code"
	default false if XTENSA_PLATFORM_LX60
	default true
	help
	  Tensilica Avnet FPGA Boards (LX60, LX200) are currently experiencing 
	  a problem with nanosleep(). We have tried to to run with Generic
	  Time but stability doesn't seem to be reproducable. Not using it
	  for now with LX60.


config XTENSA_CALIBRATE_CCOUNT
	bool "Calibrate/Auto-Configure the CPU Clock Rate"
	default y if XTENSA_PLATFORM_LX60
	default n
	help
	  On some platforms (XT2000, for example), the CPU clock rate can
	  vary.  The frequency can be determined, however, by measuring
	  against a well known, fixed frequency, such as an UART oscillator.

	  On the LX60 platform the CPU clock rate can be automatically 
	  configured from the FPGA registers.

config SERIAL_CONSOLE
	def_bool n

config XTENSA_ISS_NETWORK
	def_bool n

endmenu



menu "Xtensa Platform options"

choice
	prompt "Xtensa System Type"
	default XTENSA_PLATFORM_ISS

config XTENSA_PLATFORM_ISS
	bool "ISS"
	select XTENSA_CALIBRATE_CCOUNT
	select SERIAL_CONSOLE
	select XTENSA_ISS_NETWORK
	help
	  ISS is an acronym for Tensilica's Instruction Set Simulator.

config XTENSA_PLATFORM_XT2000
	bool "XT2000"
	select XTENSA_CALIBRATE_CCOUNT
	select PCI
	help
	  XT2000 is the name of Tensilica's feature-rich emulation platform.
	  This hardware is capable of running a full Linux distribution.

config XTENSA_PLATFORM_S6105
	bool "S6105"
	select SERIAL_CONSOLE

config XTENSA_PLATFORM_LX60
	bool "LX60"
	select OPENCORES_ETHERNET
	help
	  LX60 (XTAV60) is the name of the new Tensilica board. 
	  This hardware is capable of running a full Linux distribution.
	  The LX200 (XTAV200) is currenty using the same platform though
	  the clock speeds are slightly different.

config XTENSA_PLATFORM_S56XX
	bool "s56xx"
	help
	  S5000 platform

config XTENSA_PLATFORM_CUSTOM
	bool "Custom Xtensa platform"
	help
	Select this variant to use a custom platform.
	You will be prompted for a platform name.

endchoice
config XTENSA_PLATFORM_CUSTOM_NAME
	string "Custom Platform Name"
	depends on XTENSA_PLATFORM_CUSTOM
	default ""

config XTENSA_PLATFORM_NAME
	string
	default "iss" if XTENSA_PLATFORM_ISS
	default "xt2000" if XTENSA_PLATFORM_XT2000
	default "lx60" if XTENSA_PLATFORM_LX60
	default "s5000" if XTENSA_PLATFORM_S5000
	default XTENSA_PLATFORM_CUSTOM_NAME if XTENSA_PLATFORM_CUSTOM

config XTENSA_CPU_CLOCK_UNITS
	int
	default  1000
	help
	  The CPU Clock Rate in defined in KiloHz, so the
	  actual clock rate is multiplied by this scale
	  factor.

config XTENSA_CPU_CLOCK
	int "Clock rate in Khz to use if can't be determined with XTENSA_CALIBRATE_CCOUNT"
	default "41667"
	help
	  Specify the CPU Clock Rate in KiloHz. This value is used to
	  derive system clock parameters if XTENSA_CALIBRATE_CCOUNT
	  isn't selected or the selected platform doesn't have a
	  mechanism to determine the clock rate automatically.
	
config GENERIC_CALIBRATE_DELAY
	bool "Auto calibration of the BogoMIPS value"
	help
	  The BogoMIPS value can easily be derived from the CPU frequency.

config CMDLINE_BOOL
	bool "Default bootloader kernel arguments"

config CMDLINE
	string "Initial kernel command string"
	depends on CMDLINE_BOOL
	default "console=ttyS0,38400 root=/dev/ram"
	help
	  On some architectures (EBSA110 and CATS), there is currently no way
	  for the boot loader to pass arguments to the kernel. For these
	  architectures, you should supply some command-line options at build
	  time by entering them here. As a minimum, you should specify the
	  memory size and the root device (e.g., mem=64M root=/dev/nfs).

config BLK_DEV_SIMDISK_COUNT
	int "number of hostfile-based simulated block devices"
	depends on XTENSA_PLATFORM_ISS
	default 2

config SIMDISK0_FILENAME
	string "Host filename for a simulated device"
	depends on XTENSA_PLATFORM_ISS
	default "x"
	help
	Attach a first simdisk to a host file. Conventionally, this file
	contains a root file system.

config SIMDISK1_FILENAME
	string "Host filename for a simulated device"
	depends on XTENSA_PLATFORM_ISS && (BLK_DEV_SIMDISK_COUNT != 0)
	default "x"
	help
	Another simulated disk in a host file for a buildroot-independent
	storage.

config ARCH_SUPPORTS_OPROFILE
	bool
	default y

config ARCH_SUPPORTS_OPTIMIZED_INLINING
	bool
	default y

source "mm/Kconfig"

endmenu


menu "Xtensa Bus options"

config PCI
	bool "PCI support" if !XTENSA_PLATFORM_LX60
	depends on !XTENSA_PLATFORM_LX60
	default y
	help
	  Find out whether you have a PCI motherboard. PCI is the name of a
	  bus system, i.e. the way the CPU talks to the other stuff inside
	  your box. Other bus systems are ISA, EISA, MicroChannel (MCA) or
	  VESA. If you have PCI, say Y, otherwise N.

source "drivers/pci/Kconfig"

config HOTPLUG
	bool "Support for hot-pluggable devices"
	help
	  Say Y here if you want to plug devices into your computer while
	  the system is running, and be able to use them quickly.  In many
	  cases, the devices can likewise be unplugged at any time too.

	  One well known example of this is PCMCIA- or PC-cards, credit-card
	  size devices such as network cards, modems or hard drives which are
	  plugged into slots found on all modern laptop computers.  Another
	  example, used on modern desktops as well as laptops, is USB.

	  Enable HOTPLUG and build a modular kernel.  Get agent software
	  (from <http://linux-hotplug.sourceforge.net/>) and install it.
	  Then your kernel will automatically call out to a user mode "policy
	  agent" (/sbin/hotplug) to load modules and set up software needed
	  to use devices as you hotplug them.

source "drivers/pcmcia/Kconfig"

source "drivers/pci/hotplug/Kconfig"

endmenu

menu "Xtensa Executable file formats"

# only elf supported
config KCORE_ELF
	def_bool y
        depends on PROC_FS
        help
          If you enabled support for /proc file system then the file
          /proc/kcore will contain the kernel core image in ELF format. This
          can be used in gdb:

          $ cd /usr/src/linux ; gdb vmlinux /proc/kcore

          This is especially useful if you have compiled the kernel with the
          "-g" option to preserve debugging information. It is mainly used
	  for examining kernel data structures on the live kernel.

source "fs/Kconfig.binfmt"

endmenu

source "net/Kconfig"

source "drivers/Kconfig"

source "fs/Kconfig"

menu "Xtensa initrd options"
	depends on BLK_DEV_INITRD

config EMBEDDED_RAMDISK
	bool "Embeded root filesystem ramdisk into the kernel"

config EMBEDDED_RAMDISK_IMAGE
	string "Filename of gzipped ramdisk image"
	depends on EMBEDDED_RAMDISK
	default "ramdisk.gz"
	help
	  This is the filename of the ramdisk image to be built into the
	  kernel.  Relative pathnames are relative to arch/xtensa/boot/ramdisk/.
	  The ramdisk image is not part of the kernel distribution; you must
	  provide one yourself.
endmenu

source "arch/xtensa/Kconfig.debug"

source "security/Kconfig"

source "crypto/Kconfig"

source "lib/Kconfig"
```
